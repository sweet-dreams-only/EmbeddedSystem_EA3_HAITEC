AUTOSAR XML (schema 3.1.2)
package /NXTR_DEF
  ecu parameter definition AUTOSARParameterDefinition: module=SpiNxt
  module definition SpiNxt [0..1]: variants pre-compile  # Configuration of the Nxtr SPI handler driver module
    container SpiNxtGeneral  # This container defines the Spi configuration.
      enumeration SpiNxtUseWith: {D_SPINXT_USEWITHTC, D_SPINXT_USEWITHDIGMSB}, origin=NXTR  # Defines which external device the SPI is used with
      enumeration SpiNxtUseDMA: {STD_ON, STD_OFF}, origin=NXTR  # Select STD_ON if using DMA for SPI data; Select STD_OFF if not
