AUTOSAR XML (schema 3.0.1)
package /MICROSAR
  module config SchM_Rec: definition=SchM, implementation-config-variant=VARIANT-PRE-COMPILE  # Configuration of the SchM (BSW Scheduler) module.
    SchMGeneral: SchMDevErrorDetect=true, SchMVersionInfoApi=true, SchMOsSupport=true, SchMInterruptLocksAsFunction=true
    SchM_AsyncTask_1 (SchMTaskConfiguration): SchMTaskCallEcuMStartupTwo=true, SchMTaskRef=SchM_AsyncTask_1
    SchM_SyncTask_1 (SchMTaskConfiguration): SchMTaskAllowSynchronization=true, SchMTaskRef=SchM_SyncTask_1
