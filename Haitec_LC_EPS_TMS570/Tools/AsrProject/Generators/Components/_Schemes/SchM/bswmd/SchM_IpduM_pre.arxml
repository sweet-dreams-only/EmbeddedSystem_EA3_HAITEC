AUTOSAR XML (schema 3.0.1)
package /MICROSAR
  module config SchM_Rec: definition=SchM, implementation-config-variant=VARIANT-PRE-COMPILE  # Configuration of the SchM (BSW Scheduler) module.
    IpduM (SchMModuleConfiguration): SchMModuleLiteral=IpduM, SchMModuleInclude=IpduM.h, SchMModuleConfigVersion=1.0.0, SchMModuleImplementationRef=IPduMplex_Impl
      SCHM_IPDUM_INSTANCE_0 (InstanceConfiguration): SchMInstanceLiteral=SCHM_IPDUM_INSTANCE_0
        IPDUM_EXCLUSIVE_AREA_0 (ExclusiveAreaConf):
          SchMExclusiveAreaLiteral = IPDUM_EXCLUSIVE_AREA_0
          SchMExclusiveAreaDescription = This critical section has to lock global interrupts to protect common critical sections.
    IpduM_MainFunction (SchMMainFunctionMapping): SchMMainFunctionSymbol=IpduM_MainFunction, SchMModuleRef=IpduM
      SchMBswEvent
        SchMBswDerivedTimingEvent: SchMMainFunctionPeriodParamScale=1.0, SchMMainFunctionPeriodParamRef=/MICROSAR/IPduMplex/IPduMGeneral/IPduMConfigurationTimeBase
