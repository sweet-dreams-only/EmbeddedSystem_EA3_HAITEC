AUTOSAR XML (schema 3.0.1)
package /MICROSAR
  module config SchM_Rec: definition=SchM, implementation-config-variant=VARIANT-PRE-COMPILE  # Configuration of the SchM (BSW Scheduler) module.
    Xcp (SchMModuleConfiguration): SchMModuleLiteral=Xcp, SchMModuleInclude=XcpProf.h, SchMModuleConfigVersion=1.0.0, SchMModuleImplementationRef=Xcp_Impl
      SCHM_XCP_INSTANCE_0 (InstanceConfiguration): SchMInstanceLiteral=SCHM_XCP_INSTANCE_0
        XCP_EXCLUSIVE_AREA_0 (ExclusiveAreaConf): SchMExclusiveAreaLiteral=XCP_EXCLUSIVE_AREA_0, SchMExclusiveAreaDescription=
    XcpBackground (SchMMainFunctionMapping): SchMMainFunctionSymbol=XcpBackground, SchMModuleRef=Xcp
      SchMBswEvent
        SchMBswTimingEvent: SchMMainFunctionPeriod=0.005
