AUTOSAR XML (schema 3.0.1)
package /MICROSAR
  module config SchM_Rec: definition=SchM, implementation-config-variant=VARIANT-PRE-COMPILE  # Configuration of the SchM (BSW Scheduler) module.
    CanXcp (SchMModuleConfiguration): SchMModuleLiteral=CanXcp, SchMModuleInclude=CanXcp.h, SchMModuleConfigVersion=1.0.0, SchMModuleImplementationRef=CanXcp_Impl
      SCHM_CANXCP_INSTANCE_0 (InstanceConfiguration): SchMInstanceLiteral=SCHM_CANXCP_INSTANCE_0
        CANXCP_EXCLUSIVE_AREA_0 (ExclusiveAreaConf): SchMExclusiveAreaLiteral=CANXCP_EXCLUSIVE_AREA_0, SchMExclusiveAreaDescription=
    CanXcp_MainFunction (SchMMainFunctionMapping): SchMMainFunctionSymbol=CanXcp_MainFunction, SchMModuleRef=CanXcp
      SchMBswEvent
        SchMBswTimingEvent: SchMMainFunctionPeriod=0.01
